## target/linux/realtek/files-6.12/arch/mips/rtl9607c/Kconfig
```kconfig
# SPDX-License-Identifier: GPL-2.0

if RTL_MIPS_SOC

config RTK_SOC
	bool "Realtek SoC driver support"
	default y
	help
	  Build drivers/soc/realtek

config KERNEL_STACK_SIZE_ORDER
	int "Kenel Stack Size Order Configuration"
	default "2" if RTL9607C
	default "1"
	help
	 With Page Size 4K
	 1 for 8K kenel stack size
	 2 for 16K kernel stack size
	 3 for 32K kernel stack size
	 etc...

config RTK_PROC_GPIO_FILES
	bool "RTK proc gpio files Support"
	depends on RTK_SOC
	default n
	help
	 Build drivers/soc/realtek folder.

endif
```
